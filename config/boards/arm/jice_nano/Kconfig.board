## config/boards/arm/jice_nano/Kconfig.board
```kconfig
# jice!nano board configuration

# Copyright (c) 2020 Pete Johanson
# SPDX-License-Identifier: MIT

config BOARD_JICE_NANO
    bool "jice!nano"
    depends on SOC_NRF52840_QIAA

config BOARD_JICE_NANO_V2
    bool "jice!nano v2"
    depends on SOC_NRF52840_QIAA
```

## config/boards/arm/jice_nano/Kconfig.defconfig
```kconfig
# Copyright (c) 2021 The ZMK Contributors
# SPDX-License-Identifier: MIT

if BOARD_JICE_NANO || BOARD_JICE_NANO_V2

config BOARD
    default "jice_nano"

if USB_DEVICE_STACK

config USB_NRFX
    default y

endif # USB_DEVICE_STACK

config BT_CTLR
    default BT

endif # BOARD_JICE_NANO || BOARD_JICE_NANO_V2
```

## config/boards/arm/qhws42v2_nrf52840_right/Kconfig.board
```kconfig
# nice!nano board configuration

# Copyright (c) 2020 Pete Johanson
# SPDX-License-Identifier: MIT

config BOARD_QHWS42V2_NRF52840
    bool "qhws42v2 nrf52840"
    depends on SOC_NRF52840_QIAA
```

## config/boards/arm/qhws42v2_nrf52840_right/Kconfig.defconfig
```kconfig
# Copyright (c) 2021 The ZMK Contributors
# SPDX-License-Identifier: MIT

if BOARD_QHWS42V2_NRF52840

config BOARD
    default "qhws42v2_nrf52840"

if USB_DEVICE_STACK

config USB_NRFX
    default y

endif # USB_DEVICE_STACK

config BT_CTLR
    default BT

endif # BOARD_QHWS42V2_NRF52840
```

## config/boards/arm/qhws42v3_nrf52840_right/Kconfig.board
```kconfig
# nice!nano board configuration

# Copyright (c) 2020 Pete Johanson
# SPDX-License-Identifier: MIT

config BOARD_QHWS42V3_NRF52840
    bool "qhws42v3 nrf52840"
    depends on SOC_NRF52840_QIAA
```

## config/boards/arm/qhws42v3_nrf52840_right/Kconfig.defconfig
```kconfig
# Copyright (c) 2021 The ZMK Contributors
# SPDX-License-Identifier: MIT

if BOARD_QHWS42V3_NRF52840

config BOARD
    default "qhws42v3_nrf52840"

if USB_DEVICE_STACK

config USB_NRFX
    default y

endif # USB_DEVICE_STACK

config BT_CTLR
    default BT

config ZMK_BLE
    default y

config ZMK_USB
    default y

endif # BOARD_QHWS42V3_NRF52840
```

## config/boards/arm/qhws42v3_nrf52840_studio_right/Kconfig.defconfig
```kconfig
# Copyright (c) 2021 The ZMK Contributors
# SPDX-License-Identifier: MIT

if BOARD_QHWS42V3_NRF52840

config BOARD
    default "qhws42v3_nrf52840"

if USB_DEVICE_STACK

config USB_NRFX
    default y

endif # USB_DEVICE_STACK

config BT_CTLR
    default BT

endif # BOARD_QHWS42V3_NRF52840
```

## config/boards/shields/qhws42v2/Kconfig.defconfig
```kconfig
# The side with the PS2 Mouse / TP has to be the central half

if SHIELD_QHWSV2_RIGHT
# if SHIELD_QHWSV2_LEFT

config ZMK_KEYBOARD_NAME
# 	default "QHKBL"
    default "QHKB"

config ZMK_SPLIT_ROLE_CENTRAL
	default y

endif

if SHIELD_QHWSV2_LEFT || SHIELD_QHWSV2_RIGHT

config ZMK_SPLIT
	default y

endif
```

## config/boards/shields/qhws42v2/Kconfig.shield
```kconfig
# Copyright (c) 2020 Pete Johanson
# SPDX-License-Identifier: MIT

config SHIELD_QHWSV2_LEFT
	def_bool $(shields_list_contains,qhws42v2_left)

config SHIELD_QHWSV2_RIGHT
	def_bool $(shields_list_contains,qhws42v2_right)
```

## config/boards/shields/qhws42v3/Kconfig.defconfig
```kconfig
# The side with the PS2 Mouse / TP has to be the central half

if SHIELD_QH_RIGHT
# if SHIELD_QH_LEFT

config ZMK_KEYBOARD_NAME
	default "QHKBL"
#     default "QHKB"

config ZMK_SPLIT_ROLE_CENTRAL
	default y

endif

if SHIELD_QH_LEFT || SHIELD_QH_RIGHT

config ZMK_SPLIT
	default y

endif
```

## config/boards/shields/qhws42v3/Kconfig.shield
```kconfig
# Copyright (c) 2020 Pete Johanson
# SPDX-License-Identifier: MIT

config SHIELD_QH52V3_LEFT
	def_bool $(shields_list_contains,qhws42v3_left)

config SHIELD_QH42V3_RIGHT
	def_bool $(shields_list_contains,qhws42v3_right)
```

## config/boards/shields/qhws42v3_studio/Kconfig.defconfig
```kconfig
# The side with the PS2 Mouse / TP has to be the central half

if SHIELD_QH_LEFT

config ZMK_KEYBOARD_NAME
    default "QHKB3S"

config ZMK_SPLIT_ROLE_CENTRAL
	default y

endif

if SHIELD_QH_LEFT || SHIELD_QH_RIGHT

config ZMK_SPLIT
	default y
endif
```

## config/boards/shields/qhws42v3studio/Kconfig.defconfig
```kconfig
# The side with the PS2 Mouse / TP has to be the central half

if SHIELD_QH42V3S_RIGHT

config ZMK_KEYBOARD_NAME
    default "QHKB3S"

config ZMK_SPLIT_ROLE_CENTRAL
	default y

config ZMK_STUDIO
	default y

config ZMK_SPLIT_BLE_CENTRAL_BATTERY_LEVEL_PROXY
	default y
config ZMK_SPLIT_BLE_CENTRAL_BATTERY_LEVEL_FETCHING
	default y

endif

if SHIELD_QH42V3S_LEFT || SHIELD_QH42V3S_RIGHT

config ZMK_SPLIT
	default y
endif
```

## config/boards/shields/qhws42v3studio/Kconfig.shield
```kconfig
# Copyright (c) 2020 Pete Johanson
# SPDX-License-Identifier: MIT

config SHIELD_QH42V3S_LEFT
	def_bool $(shields_list_contains,qhws42v3studio_left)

config SHIELD_QH42V3S_RIGHT
	def_bool $(shields_list_contains,qhws42v3studio_right)
```

## config/west.yml
```yaml
manifest:
  remotes:
    - name: zmkfirmware
      url-base: https://github.com/zmkfirmware
    - name: urob
      url-base: https://github.com/urob
    - name: infused-kim
      url-base: https://github.com/infused-kim
    - name: jsenjobs
      url-base: https://github.com/jsenjobs
    - name: infused-kim
      url-base: https://github.com/infused-kim
    - name: dhruvinsh
      url-base: https://github.com/dhruvinsh
  projects:
    # - name: zmk
    #   path: zmk
    #   remote: zmkfirmware
    #   revision: main
    #   import: app/west.yml

    # - name: zmk
    #   path: zmk
    #   remote: jsenjobs
    #   revision: mouse_ps2_v2_scroll
    #   import: app/west.yml

    - name: zmk
      remote: jsenjobs
      revision: pr-testing/mouse_ps2_module_base
      import: app/west.yml
    # - name: zmk
    #   remote: infused-kim
    #   revision: pr-testing/mouse_ps2_module_base
    #   import: app/west.yml
    # Module for PS/2 mouse & TP driver
    - name: kb_zmk_ps2_mouse_trackpoint_driver
      remote: infused-kim
      revision: dev/2024-04-acceleration
    # zmk module for nice_peri_view
    - name: tmp-npv
      remote: infused-kim
      revision: main
    # Urob's zmk helpers that contain key position defines
    - name: zmk-helpers
      remote: urob
      revision: v2 # this will eventually become main
    # Tri-state behavior to make cmd+tab switching key
    # Used to be a key feature in urob's fork
    - name: zmk-tri-state
      remote: dhruvinsh
      revision: main


    # - name: zmk
    #   remote: infused-kim
    #   revision: pr-testing/mouse_ps2_v2
    #   import: app/west.yml
  self:
    path: config
```
